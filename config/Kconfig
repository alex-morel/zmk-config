## config/boards/shields/pmw3610_test/Kconfig.defconfig
```kconfig
if SHIELD_PMW3610_TEST

config ZMK_KEYBOARD_NAME
    default "PMW3610Test"

endif
```

## config/src/pointing/Kconfig
```kconfig
if ZMK_POINTING

config ZMK_INPUT_PROCESSOR_AXISLOCK
    bool "Axis-lock (straighter movement) Input Processor"
    default y
    depends on DT_HAS_ZMK_INPUT_PROCESSOR_AXISLOCK_ENABLED

endif
```
