/*
 * A trackball agora e PERIFERICO do splitkb_dongle (ver
 * pmw3610_test.overlay) e compartilha o MESMO physical-layout de 52
 * posicoes (default_layout, splitkb-common.dtsi) -- por isso precisa de um
 * zmk,keymap com bindings do mesmo tamanho. Perifericos nao interpretam
 * keymap de verdade (so a CENTRAL/dongle faz isso; o periferico so usa o
 * kscan+transform pra saber qual POSICAO GLOBAL reportar por BLE), entao
 * as 46 primeiras posicoes aqui (as teclas de digitar, que esta peca nunca
 * aciona -- o kscan dela so cobre as posicoes 46-51, os proprios botoes)
 * sao so placeholder pra bater a contagem. Reusa o keymap de verdade
 * (splitkb.keymap) por #include em vez de duplicar -- evita divergencia.
 */
#include "splitkb.keymap"
