/*
 * Filtro de ruido/zona morta CUSTOMIZADO deste projeto -- pedido explicito
 * pra reduzir os pequenos saltos que sobram da folga mecanica residual da
 * trackball. Uso: <&zip_xy_deadzone LIMIAR> (LIMIAR = param1, |valor|
 * menor que isso e descartado).
 */

#include <zephyr/dt-bindings/input/input-event-codes.h>

/ {
    /omit-if-no-ref/ zip_xy_deadzone: zip_xy_deadzone {
        compatible = "zmk,input-processor-deadzone";
        #input-processor-cells = <1>;
        type = <INPUT_EV_REL>;
        codes = <INPUT_REL_X INPUT_REL_Y>;
    };
};
