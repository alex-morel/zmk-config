## config/boards/shields/splitkb/Kconfig.defconfig
```kconfig
# ============================================================
# DONGLE = central (roda o keymap, fala com o PC, tem a tela)
# ============================================================
if SHIELD_SPLITKB_DONGLE

config ZMK_KEYBOARD_NAME
    default "The Big Zero"

config ZMK_SPLIT_ROLE_CENTRAL
    default y
    # Widgets da tela custom do dongle. Pendurados aqui (no central) de
    # proposito: os widgets tem `depends on ZMK_SPLIT_ROLE_CENTRAL`, entao so
    # o dongle os liga; as metades (perifericas) nem os compilam. select em
    # vez de "config ... default y" pra evitar erro de ordem de parse.
    select ZMK_WIDGET_LAYER_STATUS
    select ZMK_WIDGET_OUTPUT_STATUS

# Duas metades conectam no dongle (antes: 1 periferico no central).
config ZMK_SPLIT_BLE_CENTRAL_PERIPHERALS
    default 2

endif

# ============================================================
# Split ligado nas tres pecas
# ============================================================
if SHIELD_SPLITKB_LEFT || SHIELD_SPLITKB_RIGHT || SHIELD_SPLITKB_DONGLE

config ZMK_SPLIT
    default y

endif

# ============================================================
# METADES — OLED mono (SSD1306) em retrato, tela custom
# ============================================================
if SHIELD_SPLITKB_LEFT || SHIELD_SPLITKB_RIGHT

if ZMK_DISPLAY

config I2C
    default y

config SSD1306
    default y

# Tela CUSTOM em retrato via CANVAS rotacionado (nao usa rotacao de display,
# que trava OLED mono). Ver custom_status_screen.c.
choice ZMK_DISPLAY_STATUS_SCREEN
    default ZMK_DISPLAY_STATUS_SCREEN_CUSTOM
endchoice

# CRITICO (igual nice!view): desenho em canvas precisa de work queue dedicada
# (stack maior) e mem pool maior. Sem isso o custom screen trava/estoura no boot.
choice ZMK_DISPLAY_WORK_QUEUE
    default ZMK_DISPLAY_WORK_QUEUE_DEDICATED
endchoice

config ZMK_DISPLAY_DEDICATED_THREAD_STACK_SIZE
    default 4096

config LV_Z_MEM_POOL_SIZE
    default 8192

# Fontes usadas pela tela custom (cada tamanho = uma fonte)
config LV_FONT_MONTSERRAT_8
    default y

config LV_FONT_MONTSERRAT_16
    default y

config LV_USE_CANVAS
    default y

endif # ZMK_DISPLAY

if LVGL

config LV_Z_VDB_SIZE
    default 100

config LV_DPI_DEF
    default 148

config LV_Z_BITS_PER_PIXEL
    default 1

choice LV_COLOR_DEPTH
    default LV_COLOR_DEPTH_1
endchoice

endif # LVGL

endif # metades

# ============================================================
# DONGLE — tela GC9A01 240x240 COLOR (RGB565), tela built-in do ZMK
# ============================================================
if SHIELD_SPLITKB_DONGLE

if ZMK_DISPLAY

config SPI
    default y

config MIPI_DBI
    default y

config GC9X01X
    default y

# DIAGNOSTICO: tela custom que pinta vermelho + "A" branco no centro, com
# cores explicitas (dongle_status_screen.c). Isola o pipeline display+LVGL do
# tema/widgets. Depois que confirmar que aparece, volta pra BUILT_IN.
choice ZMK_DISPLAY_STATUS_SCREEN
    default ZMK_DISPLAY_STATUS_SCREEN_CUSTOM
endchoice

# Fontes: 16 = default (widget de conexao usa a fonte padrao do LVGL);
# 48 = camada grande no centro.
config LV_FONT_MONTSERRAT_16
    default y

choice LV_FONT_DEFAULT
    default LV_FONT_DEFAULT_MONTSERRAT_16
endchoice

# 28 = "YE NOT GUILTY" da animacao (cabe na tela); 48 = camada / scroll.
config LV_FONT_MONTSERRAT_28
    default y

config LV_FONT_MONTSERRAT_48
    default y

# Widget de label: o jeito certo (padrao do prospector) e amarrar o
# select na propria escolha da tela custom. LV_USE_LABEL e o simbolo real
# do LVGL (LV_OBJ_LABEL era wrapper interno do ZMK, nao settavel de fora).
config ZMK_DISPLAY_STATUS_SCREEN_CUSTOM
    select LV_USE_LABEL

# Buffer maior que a OLED: 240x240 @ 16bpp.
choice ZMK_DISPLAY_WORK_QUEUE
    default ZMK_DISPLAY_WORK_QUEUE_DEDICATED
endchoice

config ZMK_DISPLAY_DEDICATED_THREAD_STACK_SIZE
    default 4096

# Pool do LVGL no valor de referencia (englmaxi usa 16KB; prospector 10KB).
config LV_Z_MEM_POOL_SIZE
    default 16384

endif # ZMK_DISPLAY

if LVGL

# LV_Z_VDB_SIZE e PORCENTAGEM da tela (1..100). Com 10% o LVGL renderiza em
# muitos pedacos e a tela complexa (widgets+overlay) saia com artefato de
# flush parcial (listras verticais). O prospector roda tela redonda color
# num nRF52840 igual com 100 -> buffer da tela toda. Cabe.
config LV_Z_VDB_SIZE
    default 100

config LV_DPI_DEF
    default 130

config LV_Z_BITS_PER_PIXEL
    default 16

choice LV_COLOR_DEPTH
    default LV_COLOR_DEPTH_16
endchoice

# Byte-swap do RGB565 (padrao do prospector). O nRF e little-endian, entao
# o vermelho 0xF800 saia como 0x00F8 = AZUL pro painel (foi o que apareceu
# no teste). Com o swap sai 0xF800 = vermelho certo.
config LV_COLOR_16_SWAP
    default y

# Refresh do LVGL a 50ms (20fps). Um frame CHEIO de 240x240x16bpp = 115KB =
# ~115ms no SPI a 8MHz (fios dupont); o default de 33ms pede mais flushes do
# que o barramento entrega e satura a fila do display. O prospector usa 20ms
# porque roda SPI a 31MHz em PCB -- quando a tela for soldada e o SPI subir,
# da pra baixar isto tambem.
config LV_DEF_REFR_PERIOD
    default 50

# REFRESH COMPLETO: toda atualizacao redesenha o frame inteiro desde (0,0).
# Motivo: com updates PARCIAIS, um comando de janela (CASET/RASET) corrompido
# pela SPI em dupont fazia o desenho aterrissar DESLOCADO e o erro acumulava
# (sintoma: numero da camada "andando" a cada acionamento, deixando fantasma).
# Com full refresh um frame corrompido se auto-corrige no seguinte. Custo:
# ~115ms por update a 8MHz -- ok pra tela de status. Quando a tela for
# SOLDADA (SPI confiavel a 30MHz+), da pra remover isto e voltar ao parcial.
config LV_Z_FULL_REFRESH
    default y

endif # LVGL

endif # dongle
```

## config/boards/shields/splitkb/Kconfig.shield
```kconfig
config SHIELD_SPLITKB_LEFT
    def_bool $(shields_list_contains,splitkb_left)

config SHIELD_SPLITKB_RIGHT
    def_bool $(shields_list_contains,splitkb_right)

config SHIELD_SPLITKB_DONGLE
    def_bool $(shields_list_contains,splitkb_dongle)
```
